## drivers/sensor/Kconfig
```kconfig
# Copyright (c) 2024 CATIE
# SPDX-License-Identifier: Apache-2.0

if SENSOR

rsource "as621x/Kconfig"

endif # SENSOR
```

## drivers/sensor/ams-as621x/Kconfig
```kconfig
# AS621X temperature sensor configuration options

# Copyright (c) 2024 CATIE
# SPDX-License-Identifier: Apache-2.0

menuconfig AMS_AS621X
    bool "AMS AS621X temperature sensor"
    default y
    depends on DT_HAS_AMS_AS621X_ENABLED
    select I2C
    help
      Enable driver for AMS AS621X temperature sensor.

if AMS_AS621X

choice
	prompt "Conversion rate"
	default AS621X_CONVERSION_RATE_4HZ
	help
	  Select the conversion rate of the sensor.
config AS621X_CONVERSION_RATE_0_25HZ
  bool "0.25 Hz"
config AS621X_CONVERSION_RATE_1HZ
  bool "1 Hz"
config AS621X_CONVERSION_RATE_4HZ
  bool "4 Hz"
config AS621X_CONVERSION_RATE_8HZ
  bool "8 Hz"
endchoice

endif # AMS_AS621X
```

## drivers/sensor/ams/Kconfig
```kconfig
# Copyright (c) 2024 CATIE
# SPDX-License-Identifier: Apache-2.0

rsource "as621x/Kconfig"
```

## drivers/sensor/as621x/Kconfig
```kconfig
# AS621X temperature sensor configuration options

# Copyright (c) 2024 CATIE
# SPDX-License-Identifier: Apache-2.0

menuconfig AS621X
	bool "AMS AS621X temperature sensor"
	default y
	depends on DT_HAS_AMS_AS621X_ENABLED
	select I2C
	help
	  Enable driver for AMS AS621X temperature sensor.

if AS621X

choice AS621X_TRIGGER_MODE
	prompt "Temperature sensor trigger mode"
	default AS621X_TRIGGER_NONE
	help
	  Specify the type of triggering to be used by the driver.

config AS621X_TRIGGER_NONE
	bool "No trigger"

config AS621X_TRIGGER_GLOBAL_THREAD
	bool "Use global thread"
	select AS621X_TRIGGER

config AS621X_TRIGGER_OWN_THREAD
	bool "Use own thread"
	select AS621X_TRIGGER

endchoice

choice AS621X_CONVERSION_RATE
	prompt "Conversion rate"
	default AS621X_CONVERSION_RATE_4HZ
	help
	  Select the conversion rate of the sensor.

config AS621X_CONVERSION_RATE_0_25HZ
	bool "0.25 Hz"
config AS621X_CONVERSION_RATE_1HZ
	bool "1 Hz"
config AS621X_CONVERSION_RATE_4HZ
	bool "4 Hz"
config AS621X_CONVERSION_RATE_8HZ
	bool "8 Hz"

endchoice

endif # AMS_AS621X
```

## dts/bindings/sensor/ams,as621x.yaml
```yaml
# Copyright (c) 2024 CATIE
# SPDX-License-Identifier: Apache-2.0

description: |
    AMS AS621x temperature sensor

compatible: "ams,as621x"

include: [sensor-device.yaml, i2c-device.yaml]
```

## samples/sample.yaml
```yaml
sample:
  name: AS621x Temperature Sensor
tests:
  sample.default:
    tags: sensor
    integration_platforms:
      - zest_core_stm32l4a6rg
    depends_on: i2c
```
